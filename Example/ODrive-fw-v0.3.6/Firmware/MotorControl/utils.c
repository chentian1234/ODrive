
#include "utils.h"
#include "FreeRTOS.h"
#include "task.h"
#include "math.h"
#include "stm32f4xx_hal.h"

/* ========================================================================== */
/*                         SVM算法使用的预计算常量                              */
/* ========================================================================== */

/**
 * @brief 1/√3 的预计算值
 * @details √3 ≈ 1.73205080757，因此 1/√3 ≈ 0.57735026919
 *          该值在SVM算法中用于判断矢量所在的扇区：
 *          - tan(30°) = 1/√3，作为扇区边界的斜率
 *          - 用于将β分量转换为与α分量可比较的比例值
 *          预计算为常量避免在运行时进行浮点开方和除法运算，提高执行效率。
 */
static const float one_by_sqrt3 = 0.57735026919f;

/**
 * @brief 2/√3 的预计算值
 * @details √3 ≈ 1.73205080757，因此 2/√3 ≈ 1.15470053838
 *          该值在SVM算法中用于计算矢量作用时间：
 *          - 在伏秒平衡方程中，相邻矢量的作用时间计算需要乘以 2/√3
 *          - 这是SVM合成矢量的关键系数
 *          预计算为常量避免运行时除法运算。
 */
static const float two_by_sqrt3 = 1.15470053838f;

/* ========================================================================== */
/*                     空间矢量调制（SVM）函数实现                              */
/* ========================================================================== */

/**
 * @brief 空间矢量调制（SVM）算法完整实现
 *
 * @details
 * 空间矢量调制（Space Vector Modulation, SVM）是三相逆变器PWM调制的核心算法，
 * 广泛应用于电机FOC（磁场定向控制）系统中。
 *
 * ========================== 算法原理详解 ==========================
 *
 * 【1. 三相逆变器的开关状态】
 * 三相桥式逆变器有3个桥臂（A、B、C），每个桥臂有上下两个开关管。
 * 为避免直通短路，同一桥臂上下管不能同时导通。因此有2³=8种开关状态：
 * - 6个有效状态：V1(100)、V2(110)、V3(010)、V4(011)、V5(001)、V6(101)
 * - 2个零状态：  V0(000)、V7(111) —— 三相输出相同，线电压为零
 *
 * 【2. 空间电压矢量】
 * 将6个有效开关状态映射到α-β平面，得到6个空间电压矢量：
 * - 它们幅值相等（2/3·Vdc），方向互差60°，构成正六边形的6个顶点
 * - V1指向0°，V2指向60°，V3指向120°，依此类推
 * - 六边形被分为6个扇区（sextant），每个扇区60°
 *
 * 【3. 矢量合成原理】
 * 在任一扇区内，目标电压矢量可由相邻的两个有效矢量和零矢量合成：
 *   Vref = (T1/Ts)·V1 + (T2/Ts)·V2 + (T0/Ts)·V0
 * 其中T1、T2为有效矢量的作用时间，T0为零矢量作用时间，Ts为PWM周期。
 * 根据伏秒平衡：T1 + T2 + T0 = Ts
 *
 * 【4. 扇区判断】
 * 利用tan(30°) = 1/√3作为边界斜率，通过比较β/α与±1/√3的关系确定扇区：
 * - 第一象限(α≥0, β≥0)：若β/α > 1/√3 → 扇区2，否则 → 扇区1
 * - 第二象限(α<0, β≥0)： 若-β/α > 1/√3 → 扇区3，否则 → 扇区2
 * - 第四象限(α≥0, β<0)： 若-β/α > 1/√3 → 扇区5，否则 → 扇区6
 * - 第三象限(α<0, β<0)：  若β/α > 1/√3 → 扇区4，否则 → 扇区5
 *
 * 【5. PWM占空比计算】
 * 计算得到T1、T2后（归一化为Ts=1），采用七段式SVM对称分布：
 *   tA = (1 - T1 - T2) / 2    ← 零矢量均分
 *   tB = tA + T1
 *   tC = tB + T2
 * 各扇区的相位分配不同，需要根据扇区编号调整A/B/C三相的对应关系。
 *
 * 【6. 线性调制区限制】
 * SVM的线性调制区最大输出幅值为 Vdc/√3（相电压峰值），
 * 对应α-β平面上内切于六边形的圆，半径为√3/2 ≈ 0.866。
 * 超过此值进入过调制区，输出波形将产生失真。
 *
 * @param[in]  alpha α轴电压分量（Clarke变换结果，归一化值）
 * @param[in]  beta  β轴电压分量（Clarke变换结果，归一化值）
 * @param[out] tA    A相PWM占空比输出（0.0~1.0）
 * @param[out] tB    B相PWM占空比输出（0.0~1.0）
 * @param[out] tC    C相PWM占空比输出（0.0~1.0）
 * @return 状态码：0表示成功，-1表示输入超出线性调制区
 */
int SVM(float alpha, float beta, float* tA, float* tB, float* tC) {
    int Sextant;  // 扇区编号（1~6）

    /* ===== 扇区判断 =====
     * 根据α-β矢量的坐标位置，确定其所在的60°扇区。
     * 使用 1/√3 作为边界斜率进行判断。
     * 判断顺序：先判断β的正负确定上半平面/下半平面，
     *           再判断α的正负确定象限，
     *           最后用斜率阈值精确判定扇区。
     */
    if (beta >= 0.0f) {
        if (alpha >= 0.0f) {
            // 第一象限：α≥0, β≥0
            // 边界线斜率 = 1/√3 ≈ 0.577（即30°线）
            // β > α·tan(30°) → 在30°线上方 → 扇区2（30°~90°）
            // 否则 → 扇区1（0°~30°）
            if (one_by_sqrt3 * beta > alpha)
                Sextant = 2; // 扇区2：V2-V3边界区域（30°~90°）
            else
                Sextant = 1; // 扇区1：V1-V2边界区域（0°~30°）

        } else {
            // 第二象限：α<0, β≥0
            // 边界线斜率 = -1/√3（即150°线，在第二象限表现为-β/α = 1/√3）
            // -β > α·tan(30°) 等价于 β/(-α) > 1/√3
            if (-one_by_sqrt3 * beta > alpha)
                Sextant = 3; // 扇区3：V3-V4边界区域（90°~150°）
            else
                Sextant = 2; // 扇区2：V2-V3边界区域（30°~90°的延续）
        }
    } else {
        if (alpha >= 0.0f) {
            // 第四象限：α≥0, β<0
            // 边界线对应330°（即-30°）
            if (-one_by_sqrt3 * beta > alpha)
                Sextant = 5; // 扇区5：V5-V6边界区域（210°~270°的对应）
            else
                Sextant = 6; // 扇区6：V6-V1边界区域（330°~360°/0°）
        } else {
            // 第三象限：α<0, β<0
            // 边界线对应210°（即180°+30°）
            if (one_by_sqrt3 * beta > alpha)
                Sextant = 4; // 扇区4：V4-V5边界区域（150°~210°）
            else
                Sextant = 5; // 扇区5：V5-V6边界区域（210°~270°）
        }
    }

    /* ===== 计算各矢量的作用时间并生成PWM占空比 =====
     * 根据所在扇区，使用相邻两个有效矢量合成目标矢量。
     * 通过伏秒平衡方程计算各矢量的归一化作用时间（以PWM周期Ts=1为基准），
     * 然后转换为三相PWM的占空比。
     *
     * 七段式SVM的PWM序列在一个周期内对称分布：
     *   ... → 零矢量 → Vx → Vy → 零矢量 → Vy → Vx → 零矢量 → ...
     * 这种对称分布可以减少输出谐波，是SVM优于SPWM的关键之一。
     */
    switch (Sextant) {
        // ===== 扇区1：V1-V2区域（0°~60°）=====
        // 目标矢量由V1和V2合成
        // V1 = (1, 0), V2 = (1/2, √3/2)
        // 解方程组得：t1 = α - β/√3, t2 = 2β/√3
        case 1: {
            // 矢量V1和V2的归一化作用时间
            float t1 = alpha - one_by_sqrt3 * beta;    // V1的作用时间
            float t2 = two_by_sqrt3 * beta;            // V2的作用时间

            // PWM占空比计算（七段式对称分布）
            // tA从零矢量中点开始，依次加上t1和t2得到tB和tC的切换点
            *tA = (1.0f - t1 - t2) * 0.5f;  // 零矢量时间的一半作为起始点
            *tB = *tA + t1;                  // A相切换后经过t1时间B相切换
            *tC = *tB + t2;                  // B相切换后经过t2时间C相切换

            break;
        }

        // ===== 扇区2：V2-V3区域（60°~120°）=====
        // 目标矢量由V2和V3合成
        // V2 = (1/2, √3/2), V3 = (-1/2, √3/2)
        case 2: {
            // 矢量V2和V3的归一化作用时间
            float t2 = alpha + one_by_sqrt3 * beta;    // V2的作用时间
            float t3 = -alpha + one_by_sqrt3 * beta;   // V3的作用时间

            // PWM占空比计算（扇区2中B相作为基准相）
            *tB = (1.0f - t2 - t3) * 0.5f;  // B相从零矢量中点开始
            *tA = *tB + t3;                  // 经过t3时间A相切换
            *tC = *tA + t2;                  // 经过t2时间C相切换

            break;
        }

        // ===== 扇区3：V3-V4区域（120°~180°）=====
        // 目标矢量由V3和V4合成
        // V3 = (-1/2, √3/2), V4 = (-1, 0)
        case 3: {
            // 矢量V3和V4的归一化作用时间
            float t3 = two_by_sqrt3 * beta;        // V3的作用时间
            float t4 = -alpha - one_by_sqrt3 * beta; // V4的作用时间

            // PWM占空比计算（扇区3中B相作为基准相）
            *tB = (1.0f - t3 - t4) * 0.5f;
            *tC = *tB + t3;
            *tA = *tC + t4;

            break;
        }

        // ===== 扇区4：V4-V5区域（180°~240°）=====
        // 目标矢量由V4和V5合成
        // V4 = (-1, 0), V5 = (-1/2, -√3/2)
        case 4: {
            // 矢量V4和V5的归一化作用时间
            float t4 = -alpha + one_by_sqrt3 * beta;  // V4的作用时间
            float t5 = -two_by_sqrt3 * beta;          // V5的作用时间

            // PWM占空比计算（扇区4中C相作为基准相）
            *tC = (1.0f - t4 - t5) * 0.5f;
            *tB = *tC + t5;
            *tA = *tB + t4;

            break;
        }

        // ===== 扇区5：V5-V6区域（240°~300°）=====
        // 目标矢量由V5和V6合成
        // V5 = (-1/2, -√3/2), V6 = (1/2, -√3/2)
        case 5: {
            // 矢量V5和V6的归一化作用时间
            float t5 = -alpha - one_by_sqrt3 * beta;  // V5的作用时间
            float t6 = alpha - one_by_sqrt3 * beta;    // V6的作用时间

            // PWM占空比计算（扇区5中C相作为基准相）
            *tC = (1.0f - t5 - t6) * 0.5f;
            *tA = *tC + t5;
            *tB = *tA + t6;

            break;
        }

        // ===== 扇区6：V6-V1区域（300°~360°）=====
        // 目标矢量由V6和V1合成
        // V6 = (1/2, -√3/2), V1 = (1, 0)
        case 6: {
            // 矢量V6和V1的归一化作用时间
            float t6 = -two_by_sqrt3 * beta;           // V6的作用时间
            float t1 = alpha + one_by_sqrt3 * beta;    // V1的作用时间

            // PWM占空比计算（扇区6中A相作为基准相）
            *tA = (1.0f - t6 - t1) * 0.5f;
            *tC = *tA + t1;
            *tB = *tC + t6;

            break;
        }
    }

    /* ===== 越界检查 =====
     * 验证计算出的PWM占空比是否在合法范围[0, 1]内。
     * 如果超出范围，说明输入矢量幅值超过了SVM的线性调制区限制（√3/2），
     * 此时输出波形将失真，返回错误码-1通知调用者。
     * 调用者应对输入进行限幅处理，确保α-β矢量幅值不超过√3/2。
     */
    int retval = 0;
    if (
        *tA < 0.0f
        || *tA > 1.0f
        || *tB < 0.0f
        || *tB > 1.0f
        || *tC < 0.0f
        || *tC > 1.0f
    ) retval = -1;
    return retval;
}

/* ========================================================================== */
/*                        角度归一化函数实现                                    */
/* ========================================================================== */

/**
 * @brief 角度归一化函数：将角度约束到[-π, π)区间
 *
 * @details
 * 在电机FOC控制中，电角度会随时间不断累加。当角度超过π或小于-π时，
 * 需要将其归一化到[-π, π)区间，以保持角度值的连续性和有界性。
 *
 * 实现方式：
 * - 当角度≥π时，不断减去2π直到小于π
 * - 当角度<-π时，不断加上2π直到大于等于-π
 *
 * 注意：该方法对于角度偏离[-π, π)较近时效率较高。
 * 如果角度值非常大（例如经过长时间累加），可能需要多次循环，
 * 此时建议使用 fmodf() 函数进行归一化。
 *
 * @param[in] theta 输入角度（弧度制），可以是任意值
 * @return 归一化后的角度，范围为 [-π, π)
 * @warning 对于非常大的角度值，循环次数较多，可能影响实时性能
 */
// 警告：注意不要传入过大的角度值！
float wrap_pm_pi(float theta) {
    // 角度上界归一化：如果角度大于等于π，减去2π
    while (theta >= M_PI) theta -= (2.0f * M_PI);
    // 角度下界归一化：如果角度小于-π，加上2π
    while (theta < -M_PI) theta += (2.0f * M_PI);
    return theta;
}

/* ========================================================================== */
/*                      快速atan2近似算法实现                                   */
/* ========================================================================== */

/**
 * @brief 快速atan2函数：使用多项式近似的二维反正切计算
 *
 * @details
 * atan2(y, x) 计算点(x, y)与原点连线相对于x轴正方向的角度，
 * 是电机FOC控制中估算转子角度的重要函数。
 *
 * 标准库的atan2()函数精度高但计算量大（涉及多次除法、开方、级数展开），
 * 在资源受限的嵌入式MCU上可能成为性能瓶颈。本函数使用多项式近似法，
 * 在保持足够精度的同时将计算速度提升3~5倍。
 *
 * ======================== 算法原理详解 ========================
 *
 * 【算法来源】
 * 基于 https://math.stackexchange.com/a/1105038/81278 中的近似公式
 *
 * 【步骤1：利用对称性归约到第一卦限】
 * atan2具有以下对称性质：
 * - atan2(-y, x) = -atan2(y, x)           （x轴对称）
 * - atan2(y, -x) = π - atan2(y, x)        （y轴对称）
 * - atan2(-y, -x) = atan2(y, x) - π       （原点对称）
 * - 当|y| > |x|时：atan2(y, x) = π/2 - atan2(x, y)  （对角线对称）
 *
 * 利用这些对称性，可以将任意象限的计算归约到区域：0 ≤ |y| ≤ |x|, x > 0
 * 在该区域内，atan2的返回值范围为[0, π/4]
 *
 * 【步骤2：变量替换】
 * 令 a = min(|x|, |y|) / max(|x|, |y|)
 * 在归约后的区域内，有 a = |y| / |x|，且 a ∈ [0, 1]
 *
 * 此时 arctan(a) 就是我们需要近似的函数，其中 a ∈ [0, 1]
 *
 * 【步骤3：多项式近似】
 * 在区间[0, 1]上，使用三次多项式逼近arctan(a)：
 *
 *   arctan(a) ≈ a + s·(C1 + s·(C2 + s·C3))·a
 *
 * 其中 s = a²，系数为：
 *   C3 = -0.0464964749    （三次项系数）
 *   C2 =  0.15931422      （二次项系数）
 *   C1 = -0.327622764     （一次项系数）
 *
 * 完整展开式：
 *   r = a + a³·(-0.327622764 + a²·(0.15931422 + a²·(-0.0464964749)))
 *     = a + s·a·(C1 + s·(C2 + s·C3))
 *
 * 这些系数是通过Minimax近似（最小化最大误差）方法优化得到的，
 * 使得在整个[0, 1]区间上的最大绝对误差最小化。
 *
 * 【步骤4：象限修正】
 * 根据原始(x, y)的符号和大小关系，对近似结果进行对称变换：
 * - 如果|y| > |x|：r = π/2 - r    （利用对角线对称性）
 * - 如果x < 0：   r = π - r       （利用y轴对称性）
 * - 如果y < 0：   r = -r          （利用x轴对称性）
 *
 * 【精度分析】
 * - 最大绝对误差：< 0.0015 弧度（约0.086度）
 * - 计算速度：比标准atan2快3~5倍（取决于平台和编译器）
 * - 适用于：电机角度估算、坐标变换等对实时性要求高、精度要求中等的场景
 *
 * @param[in] y y坐标值（分子，对应三角函数中的对边）
 * @param[in] x x坐标值（分母，对应三角函数中的邻边）
 * @return 近似角度值，范围为 (-π, π]
 */
// 算法来源: https://math.stackexchange.com/a/1105038/81278
float fast_atan2(float y, float x) {
    // 【步骤1】计算|x|和|y|，用于归约到第一卦限
    float abs_y = fabsf(y);    // |y|
    float abs_x = fabsf(x);    // |x|

    // 【步骤2】计算 a = min(|x|, |y|) / max(|x|, |y|)
    // a 的值域为 [0, 1]，在归约后的区域内 a = |y|/|x|
    float a = MACRO_MIN(abs_x, abs_y) / MACRO_MAX(abs_x, abs_y);

    // 【步骤3】计算 s = a²
    float s = a * a;

    // 【步骤4】三次多项式近似 arctan(a)
    // r = a + s·a·(C1 + s·(C2 + s·C3))
    // 使用霍纳法则（Horner's method）嵌套计算，减少乘法次数：
    // r = ((C3·s + C2)·s + C1)·s·a + a
    float r = ((-0.0464964749f * s + 0.15931422f) * s - 0.327622764f) * s * a + a;

    // 【步骤5】根据|y|与|x|的大小关系进行对角线对称修正
    // 如果|y| > |x|，说明角度在45°~90°（或对应象限）
    // 利用恒等式：arctan(y/x) = π/2 - arctan(x/y)
    if (abs_y > abs_x)
        r = 1.57079637f - r;  // π/2 ≈ 1.57079637

    // 【步骤6】根据x的符号进行y轴对称修正
    // 如果x < 0，说明角度在第二或第三象限
    // 利用恒等式：atan2(y, -x) = π - atan2(y, x)
    if (x < 0.0f)
        r = 3.14159274f - r;  // π ≈ 3.14159274

    // 【步骤7】根据y的符号进行x轴对称修正
    // 如果y < 0，说明角度在第三或第四象限（角度应为负值）
    // 利用恒等式：atan2(-y, x) = -atan2(y, x)
    if (y < 0.0f)
        r = -r;

    return r;
}

/* ========================================================================== */
/*                           正模运算函数实现                                    */
/* ========================================================================== */

/**
 * @brief 正模运算（数学意义上的取模运算）
 *
 * @details
 * C语言中的%运算符实现的是"取余"（remainder）而非"取模"（modulo）。
 * 两者的区别在于商向哪个方向取整：
 * - 取余：商向零取整（truncation），余数符号与被除数相同
 * - 取模：商向负无穷取整（floor），余数符号与除数相同
 *
 * 示例：
 *   -1 % 5   = -1   （C语言取余）
 *   mod(-1, 5) = 4  （数学取模，因为 -1 = (-1)×5 + 4）
 *
 * 在电机控制中，编码器计数、电角度计算等场景需要数学意义上的取模运算，
 * 因此实现此函数。
 *
 * 实现方法：
 * 先计算C语言取余 r = dividend % divisor，
 * 如果 r < 0，则 r += divisor，使结果始终为正。
 *
 * @param[in] dividend 被除数（可以为正或负）
 * @param[in] divisor  除数（应不为0）
 * @return 正模运算结果，范围 [0, |divisor|)
 *
 * @note 参考: https://stackoverflow.com/a/19288271
 */
// 取模运算（区别于取余），详见 https://stackoverflow.com/a/19288271
int mod(int dividend, int divisor) {
    // 先使用C语言的取余运算符
    int r = dividend % divisor;
    // 如果余数为负，加上除数使其变为正数（数学意义上的模）
    return (r < 0) ? (r + divisor) : r;
}

/* ========================================================================== */
/*                       RTOS 时间转换函数实现                                  */
/* ========================================================================== */

/**
 * @brief 将截止时间（deadline）转换为超时时间（timeout）
 *
 * @details
 * 在RTOS中，有时需要等待某个事件直到某个截止时间（deadline），
 * 但RTOS的等待函数通常接受超时时间（timeout）作为参数。
 * 本函数用于在两者之间进行转换。
 *
 * 截止时间（deadline）：一个绝对时间点（系统启动后的毫秒数）
 * 超时时间（timeout）：从当前时刻到截止时间的剩余毫秒数
 *
 * 溢出处理：
 * uint32_t类型的系统时钟在运行约49.7天后会溢出回绕。
 * 利用补码运算的性质，deadline - now 的差值即使在溢出情况下也是正确的，
 * 前提是超时时间不超过2³¹毫秒（约24.8天）。
 *
 * 通过检查差值的符号位（第31位）来判断截止时间是否已过：
 * - 如果符号位为1，说明差值为负（溢出情况下表现为很大的正数），截止已过，返回0
 * - 否则返回差值作为超时时间
 *
 * @param[in] deadline_ms 截止时间（绝对时间戳，单位：毫秒）
 * @return 超时时间（相对当前剩余的毫秒数）；如果截止时间已过则返回0
 *
 * @note 特殊情况：如果截止时间在很久以前（超过2³¹毫秒），
 *       差值的符号位可能因多次溢出而翻转，此时也会返回0，这是可接受的行为。
 */
// @brief: 返回距离截止时间还剩多少时间。
// 如果截止时间已经过去，返回值为0（除非截止时间在非常久远的过去）
uint32_t deadline_to_timeout(uint32_t deadline_ms) {
    // 获取当前系统时间（毫秒）
    // xTaskGetTickCount() 返回RTOS内核的系统滴答数
    // 通过 (1000 * tick) / frequency 转换为毫秒
    uint32_t now_ms = (uint32_t)((1000ull * (uint64_t)xTaskGetTickCount()) / configTICK_RATE_HZ);

    // 计算截止时间与当前时间的差值
    // 利用无符号整数减法的溢出特性，即使系统时钟溢出也能正确计算
    uint32_t timeout_ms = deadline_ms - now_ms;

    // 检查符号位（第31位）：
    // - 如果为1，说明 deadline < now（截止时间已过），返回0
    // - 如果为0，说明 deadline >= now，返回剩余的超时时间
    return (timeout_ms & 0x80000000) ? 0 : timeout_ms;
}

/**
 * @brief 将超时时间转换为截止时间
 *
 * @details
 * 与 deadline_to_timeout() 相反的操作。
 * 给定一个超时时长（从现在开始等待多久），计算出对应的绝对截止时间点。
 *
 * 使用场景：
 * 当你需要设置一个定时事件，例如"在100ms后执行某操作"，
 * 可以先调用此函数计算出截止时间，然后在循环中不断调用
 * deadline_to_timeout() 检查是否超时。
 *
 * @param[in] timeout_ms 超时时长（从当前时刻开始的毫秒数）
 * @return 截止时间（绝对时间戳，单位：毫秒）
 *
 * @note 由于使用无符号加法，即使 now_ms + timeout_ms 发生溢出，
 *       后续使用 deadline_to_timeout() 也能正确处理溢出情况。
 */
// @brief: 根据超时时长计算出对应的截止时间
uint32_t timeout_to_deadline(uint32_t timeout_ms) {
    // 获取当前系统时间（毫秒）
    uint32_t now_ms = (uint32_t)((1000ull * (uint64_t)xTaskGetTickCount()) / configTICK_RATE_HZ);
    // 截止时间 = 当前时间 + 超时时长
    return now_ms + timeout_ms;
}

/* ========================================================================== */
/*                         高精度时间戳函数实现                                  */
/* ========================================================================== */

/**
 * @brief 获取系统启动以来的微秒数（高精度时间戳）
 *
 * @details
 * 提供一个精度为微秒级的时间戳，适用于需要高精度定时的场景，
 * 如测量脉冲宽度、计算通信时序等。
 *
 * 实现原理：
 * 结合两个时间源来获取高精度的时间戳：
 * 1. HAL_GetTick()：RTOS的毫秒级系统滴答，提供"大尺度"时间基准
 * 2. TIM_TIME_BASE->CNT：一个运行在1MHz频率下的定时器计数器，
 *    提供毫秒内的微秒级偏移量
 *
 * 最终结果 = 毫秒数 × 1000 + 定时器计数值（微秒）
 *
 * 竞争条件处理：
 * 由于毫秒进位和定时器计数器读取不是原子操作，
 * 如果在读取毫秒值和计数器值之间发生了毫秒进位，
 * 会导致结果不准确。使用do-while循环检测并避免这种情况：
 * 先读取毫秒值，再读取计数器值，
 * 如果再次读取毫秒值发生了变化，说明发生了进位，需要重新读取。
 *
 * @return 系统启动以来的微秒数（32位无符号整数）
 * @note 32位微秒计数器约在71.5分钟后溢出回绕。
 *       如果需要更长时间跨度的高精度计时，需要额外处理溢出。
 */
// @brief: 返回系统启动以来的微秒数
uint32_t micros(void) {
    register uint32_t ms, cycle_cnt;
    do {
        ms = HAL_GetTick();           // 先读取毫秒级系统滴答
        cycle_cnt = TIM_TIME_BASE->CNT; // 再读取定时器计数器（微秒偏移）
    } while (ms != HAL_GetTick());    // 如果在此期间毫秒值发生变化，重新读取

    // 合并毫秒和微秒：毫秒×1000 + 定时器计数值
    // 假设TIM_TIME_BASE配置为1MHz计数频率，每个计数 = 1微秒
    return (ms * 1000) + cycle_cnt;
}

/* ========================================================================== */
/*                          微秒延时函数实现                                    */
/* ========================================================================== */

/**
 * @brief 微秒级精确延时（忙等待实现）
 *
 * @details
 * 使用忙等待（busy-wait / 轮询）方式实现微秒级精确延时。
 * 延时期间CPU持续运行空转循环，不会让出CPU或进入低功耗模式。
 *
 * 实现原理：
 * 1. 记录当前微秒时间戳作为起始时间
 * 2. 循环检查当前时间与起始时间的差值是否达到目标延时
 * 3. 每次循环插入NOP指令，防止编译器优化掉循环
 *
 * @param[in] us 需要延时的微秒数
 *
 * @warning 忙等待会持续占用CPU资源，在延时期间无法执行其他任务。
 *          仅适用于短时间延时（通常<100微秒）。
 *          长时间延时建议使用：
 *          - RTOS的任务延时函数（如 vTaskDelay()）
 *          - 定时器中断回调
 *          - DMA+定时器硬件方式
 */
// @brief: 忙等待延时指定的微秒数（us）
void delay_us(uint32_t us) {
    uint32_t start = micros();  // 记录起始时间戳
    // 循环等待直到经过的时间达到目标值
    while (micros() - start < (uint32_t) us) {
        __ASM("nop");  // 插入空操作指令，防止编译器优化并减少功耗
    }
}
